AUTOSAR XML (schema 00048)
package /Services
  service interface VehicleDataService
    events:
      data SpeedEvent: type=uint16
package /Deployment
  someip service interface deployment VehicleDataService_Someip: service-interface=VehicleDataService, service-interface-id=1234, service-interface-version={major-version=1, minor-version=0}
    someip event deployment SpeedEvent_Deployment: event=SpeedEvent, event-id=32769, transport-protocol=UDP
package /Components
  adaptive application sw component type SpeedProviderApp
    provide port SpeedOutPort: provided-interface=VehicleDataService
