AUTOSAR XML (schema 00048)
package /AdaptiveProject
  service interface RadarService: namespaces=symbol-props={short-namee=radar, symbol=radar}
    events:
      data ObjectDetected: type=uint32
  adaptive application sw component type RadarApplication
    provide port RadarOut: provided-interface=RadarService
package /DataTypes/Cpp
  std cpp implementation data type uint32: category=VALUE
